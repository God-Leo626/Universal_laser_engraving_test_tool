#include "data_processing.h"
#include "stdbool.h"
#include "stm32f4xx.h"
#include <stddef.h>
#include "string.h"
#include <stdio.h>
//*****************************************************************************************************************

/*******************************************************************
********************************************************************
* 名称：
* 功能：
* 参数：对比两个十六进制数组从起始位置开始指定长度的数据是否相等
        arr_a   :  数组a
        arr_b   :  数组b
        cmp_len :
* 返回值：
        true : 两个数组前 cmp_len个字节完全相同
        false : 存在差异,或参数非法(NULL/长度为0)
* 版本：v1
* 作者：matt
* 日期：2026-07-24
* 举例：
* 备注：
* 
* 
*********************************************************************
*********************************************************************/
bool hex_arr_compare(u8* arr_a, u8* arr_b, u32 cmp_len)
{
    u32 i;

    if(arr_a == NULL || arr_b == NULL || cmp_len == 0)  // 参数不合法直接返回false
    {
        return false;
    }
    // 比较指定长度数组内容，如有不同就返回false
    for(i = 0; i < cmp_len; i++)
    {
        if(arr_a[i] != arr_b[i])
        {
            return false;
        }
    }

    return true;  // 相同就返回true
}
/*******************************************************************
********************************************************************
* 名称：
* 功能： 对数组从指定起始位置到结束位置的数据进行异或校验,并校验合法性
* 参数：
        data   待校验的十六进制数组
*       start  起始位置(从0开始)
*       end    结束位置(包含该位置)
*       result 输出的异或校验值
* 返回值：
          true   校验成功,result 有效
*         false  参数非法(NULL/越界/start>end)
* 版本：v1
* 作者：matt
* 日期：2026-07-23
* 举例：
* 备注：
* 
* 如 data={0x12,0x34,0x56} start=0 end=2 → result=0x12^0x34^0x56=0x60
*********************************************************************
*********************************************************************/
bool xor_checksum_range(u8* data, u32 start, u32 end, u8* result)
{
    u32 i; // 循环计数器

    if(data == NULL || result == NULL) // 空指针检查
    {
        return false; // 参数非法
    }

    if(start > end) // 起始大于结束,参数非法
    {
        return false; // 参数非法
    }

    *result = 0; // 异或初始值清零

    for(i = start; i <= end; i++) // 从起始遍历到结束
    {
        if(data[i] > 0xFF) // 非法的十六进制数据(字节值超出范围)
        {
            return false; // 数据不符合十六进制要求
        }
        *result ^= data[i]; // 逐字节异或
    }

    return true; // 校验完成
}

/*******************************************************************
********************************************************************
* 名称：
* 功能：  将十六进制字节数组按 %02x 格式存入字符串,如 {0xAB,0x0F} → "ab0f"
* 参数：
        hex_arr 待转换的字节数组
*       arr_len 数组长度
*       out_str 输出字符串缓冲区(调用者需保证 >= arr_len*2+1)
* 返回值：
* 版本：v1
* 作者：matt
* 日期：2026-06-06
* 举例：
* 备注：
*   
* 小写输出; 若需大写将 %02x 改为 %02X
*********************************************************************
*********************************************************************/
void hex_arr_to_str(u8* hex_arr, u32 arr_len, char* out_str)
{
    u32 i;
    u32 offset = 0;

    if(hex_arr == NULL || out_str == NULL || arr_len == 0)
    {
        return;
    }

    for(i = 0; i < arr_len; i++)
    {
        offset += sprintf(out_str + offset, "%02x", hex_arr[i]);
    }
}

/*******************************************************************
********************************************************************
* 名称：
* 功能： 将十六进制字符串按每2个字符一组转换为字节数组（已知长度，无'\0'）
* 参数：
     hex_str   输入的十六进制字符串指针
 *   hex_len   字符串中有效字符的个数
 *   out       输出的字节数组
 *   out_size  out 数组的最大容量
* 返回值：
                转换成功的字节数，返回 0 表示入参不合法               
* 版本：v1
* 作者：matt
* 日期：2026-06-06
* 举例：u8 buf[20] = {0};
        u32 n = hex_str_to_bytes_by_len("7F0C820000A6", 12, buf, 20);
        // n = 6
        // buf[] = {0x7F, 0x0C, 0x82, 0x00, 0x00, 0xA6}
* 备注：
* 
* 
*********************************************************************
*********************************************************************/
u32 hex_str_to_bytes_by_len(const char *hex_str, u32 hex_len, u8 *out, u32 out_size)
{
    u32 i = 0;                                       // 源字符串索引

    if (hex_len % 2 != 0)                            // 长度必须是偶数（2个字符一组）
        return 0;                                    // 不合法，返回0

    for (i = 0; i < hex_len && (i / 2) < out_size; i += 2)  // 每次处理2个字符
    {
        char c1 = hex_str[i];                        // 高4位字符
        char c2 = hex_str[i + 1];                    // 低4位字符
        u8   h4 = 0;                                 // 高4位数值
        u8   l4 = 0;                                 // 低4位数值

        if(c1 >= '0' && c1 <= '9')  //  字符0-9 de ascii 值为 0x30-----0x39
        {
             h4 = c1 - '0';      // 0-9 → 0-9
        }           
        else if (c1 >= 'A' && c1 <= 'F')  //  'A'---'F' de ascii 值 0x41----0x46
        {
            h4 = c1 - 'A' + 10; // A-F → 10-15    
        }
        else if (c1 >= 'a' && c1 <= 'f')  //  'a'---'f' de ascii 值 0x61----0x66
        {
            h4 = c1 - 'a' + 10; // a-f → 10-15
        }            
        else 
        {
            return 0;                               // 不合法字符
        }

        
        if(c2 >= '0' && c2 <= '9')
        {
            l4 = c2 - '0';
        }
            
        else if (c2 >= 'A' && c2 <= 'F') 
        {
            l4 = c2 - 'A' + 10;
        }
            
        else if (c2 >= 'a' && c2 <= 'f')
        {
            l4 = c2 - 'a' + 10;
        }
            
        else 
        {
            return 0;                               // 不合法字符
        }

        out[i / 2] = (h4 << 4) | l4;                 // 拼接高低4位为一个字节
    }

    return hex_len / 2;                              // 返回转换成功的字节数
}

/*******************************************************************
********************************************************************
* 名称：
* 功能： 将有符号十进制字符串（如 "-40"、"09"、"127"）转换为 s8 值
* 参数： 
           str  输入字符串，如 "-40"、"09"
 *         out  输出：转换后的 s8 值
 * 
* 返回值：
           true  转换成功
 *         false 字符串格式不合法
* 版本：v1
* 作者：matt
* 日期：2026-06-06
* 举例：
* 备注：
*   s8 result = 0;

    dec_str_to_s8("-40", &result);  // result = 0xD8（-40 的补码）
    dec_str_to_s8("09",  &result);  // result = 0x09
    dec_str_to_s8("127", &result);  // result = 0x7F
    dec_str_to_s8("-128", &result); // result = 0x80
    dec_str_to_s8("abc", &result);  // 返回 false
* 
*********************************************************************
*********************************************************************/
bool dec_str_to_s8(const char *str, s8 *out)
{
    s32 val = 0;                         // 临时用 s32 接收，检测溢出
    s8  sign = 1;                        // 符号：1=正，-1=负
    u32 i = 0;                           // 字符串索引

    if (str == NULL || out == NULL)      // 空指针检查
    {
        return false;                    // 不合法，返回假
    }

    if (str[i] == '-')                   // 检测负号
    {
        sign = -1;                       // 标记为负数
        i++;                             // 跳过负号
    }
    else if (str[i] == '+')              // 检测正号
    {
        i++;                             // 跳过正号
    }

    if (str[i] == '\0')                  // 符号后面没有数字
    {
        return false;                    // 不合法，返回假
    }
    while (str[i] != '\0')               // 逐字符处理数字部分
    {
        if (str[i] < '0' || str[i] > '9')// 非数字字符
        {
            return false;                // 不合法，返回假
        } 
        val = val * 10 + (str[i] - '0'); // 累加当前位

        if (val > 128)                   // 绝对值超过 128（s8 范围 -128~127）
        {
            return false;                // 溢出，返回假
        }
        i++;                             // 移动到下一个字符
    }

    val = val * sign;                    // 应用符号

    if (val < -128 || val > 127)         // 超出 s8 范围
    {
        return false;                    // 溢出，返回假
    }
    *out = (s8)val;                      // 转换为 s8 并输出
    return true;                         // 转换成功
}

/*******************************************************************
********************************************************************
* 名称：
* 功能：  统计子串 sub 在字符串 str 中出现的次数
* 参数：
str ： 要统计的原始字符串
sub ： 要匹配的子串
* 返回值：
子串出现的次数
* 版本：v1
* 作者：matt
* 日期：2026-06-06
* 举例：
* 备注：
* 
* 
*********************************************************************
*********************************************************************/
u32 str_count_substr(const char *str, const char *sub)
{
    u32 count = 0;                    // 匹配次数初始化为0
    u32 sub_len = strlen(sub);        // 待查找子串的长度
    if (sub_len == 0)
    {
        return 0;                     // 空子串直接返回0，防止死循环
    }

    while (*str)                      // 遍历源字符串
    {
        if (strncmp(str, sub, sub_len) == 0)  // 当前位置匹配子串
        {
            count++;                  // 匹配次数加1
            str += sub_len;           // 跳过已匹配的部分（不重叠）
        }
        else
        {
            str++;                    // 不匹配，指针后移一位
        }
    }
    return count;                     // 返回匹配总次数
}


/*******************************************************************
********************************************************************
* 名称：
* 功能：  从源字符串中按 start_str ~ end_str 规则截取所有子串，
 *         判断它们是否全部相等。相等则保存该子串到 out 并返回 true。
           截取的子串的长度不能超过1000个
* 参数：
         src        源字符串
 *       start_str  起始标记字符串（作为截取起点）
 *       end_str    结束标记字符串（作为截取终点）
 *       out        输出：截取到的子串（仅在全部相等时写入）
 *       out_size   out 缓冲区大小（字节）
 *      
* 返回值：
           true       所有截取子串相等
 *         false    截取少于2个，或存在不相等的子串
* 版本：v1
* 作者：matt
* 日期：2026-06-06
* 举例：
* 备注：
* 
* 
*********************************************************************
*********************************************************************/
bool str_extract_equal(const char *src, const char *start_str, const char *end_str,char *out, u32 out_size)                      
{
    u32  cnt    = 0;                      // 截取到的子串个数
    u32  start_len = strlen(start_str);   // 起始标记长度
    u32  end_len   = strlen(end_str);     // 结束标记长度
    char first[1000] = {0};                // 保存第一个子串，用于后序比较
    char curr [1000] = {0};                // 保存当前提取的子串

    if (start_len == 0 || end_len == 0)   // 定界符为空则无法截取
    {
        return false;                     // 直接返回失败
    }       
    

    while (*src)                          // 遍历源字符串
    {
        if (strncmp(src, start_str, start_len) == 0)  // 当前位置匹配 【起始标记】
        {
            src += start_len;             // 跳过起始标记

            u32 i = 0;                    // 子串内字符索引
            bool found_end = false;       // 标记是否找到结束标记
            while (*src && i < 999)       // 未到字符串末尾且未越界
            {
                if (strncmp(src, end_str, end_len) == 0)  // 当前位置匹配结束标记
                {
                    found_end = true;     // 标记已找到
                    break;                // 停止提取
                }
                curr[i++] = *src++;       // 复制当前字符到 curr
            }
            curr[i] = '\0';               // 添加字符串结束符

            if (i > 0 && found_end)       // 非空且结束标记存在才有效
            {
                cnt++;                    // 子串计数加1
                if (cnt == 1)             // 第一个子串
                {
                    strcpy(first, curr);                // 将找到的第一个子串   保存为基准串  （用于后面的对比）
                }
                
                else if (strcmp(first, curr) != 0)      // 后续子串与第一个比较
                {
                    return false;                       // 不相等，直接返回假
                }                 
                
            }
            if (found_end)                // 只有在找到结束标记时跳过它
            {
                src += end_len;           // 跳过结束标记
            }             
            continue;                     // 继续外层循环
        }
        src++;                            // 普通字符，指针后移一位
    }

    if (cnt >= 2 && out != NULL)          // 至少2个且全部相等且输出缓冲有效
    {
        strncpy(out, first, out_size - 1);// 复制子串到输出缓冲（留一位给'\0'）
        out[out_size - 1] = '\0';         // 保证字符串结束
        return true;                      // 截取成功
    }
    return false;                         // 不满足条件，返回假
}
/*******************************************************************
********************************************************************
* 名称：
* 功能：  源字符串中按 start_str~~~~~end_str 截取数据，保存到 out
* 参数：
    src        源字符串
 *  start_str  起始标记（截取起点，本身不包含在结果中）
 *  end_str    结束标记（截取终点，本身不包含在结果中）
 *  out        输出缓冲区
 *  out_size   输出缓冲区大小（带'\0'的容量）
* 返回值：
            true  截取成功
 *          false 未找到起始或结束标记
* 版本：v1
* 作者：matt
* 日期：2026-06-06
* 举例：
* 备注：
* 
* 
*********************************************************************
*********************************************************************/
bool str_intercept(const char *src, const char *start_str, const char *end_str,char *out, u32 out_size)                      
{
    u32  start_len = strlen(start_str);   // 起始标记长度
    u32  end_len   = strlen(end_str);     // 结束标记长度
 

    if (start_len == 0 || end_len == 0)   // 定界符为空则无法截取
    {
        return false;                     // 直接返回失败
    }       
    

    while (*src)                          // 遍历源字符串
    {
        if (strncmp(src, start_str, start_len) == 0)  // 当前位置匹配 【起始标记】
        {
            src += start_len;             // 跳过起始标记

            u32 i = 0;                    // 子串内字符索引
            bool found_end = false;       // 标记是否找到结束标记
            while (*src && i <  (out_size - 1)  )     // 未到字符串末尾且未越界
            {
                if (strncmp(src, end_str, end_len) == 0)  // 当前位置匹配结束标记
                {
                    found_end = true;     // 标记已找到
                    break;                // 停止提取
                }
                out[i++] = *src++;       // 复制当前字符到 curr
            }
            out[i] = '\0';               // 添加字符串结束符

            if (i > 0 && found_end)       // 非空且结束标记存在才有效
            {
                return true  ;
            }
            else
            {
                return false ;
            }
        }
        src++;                            // 普通字符，指针后移一位
    }
    return false;                         // 不满足条件，返回假
}

/*******************************************************************
********************************************************************
* 名称：
* 功能： 从 src 开头截取到第一次出现 target 之前的所有内容，保存到 out
* 参数：
     src        源字符串
 *   target     目标标记字符串（遇到它之前的内容会被保存）
 *   out        输出缓冲区
 *   out_size   输出缓冲区大小（带'\0'的容量）
* 返回值：
    true        找到 target，截取成功
    false       未找到 target，out 内容不变
* 版本：v1
* 作者：matt
* 日期：2026-06-06
* 举例：
* 备注：
* 
* 
*********************************************************************
*********************************************************************/
bool str_extract_before_first(const char *src, const char *target, char *out, u32 out_size)                          
{
    
    u32 i = 0;                           // 输出缓冲索引
    if (!src || !target || !out || out_size == 0)
    {
         return false; 
    }
       
    
    u32 target_len = strlen(target);     // 目标标记长度
    if (target_len == 0)                 // 目标标记为空则无意义
    {
         return false;                    // 返回失败
    }
       

    while (*src)                         // 遍历源字符串
    {
        if (strncmp(src, target, target_len) == 0)  // 当前位置匹配目标标记
        {
            out[i] = '\0';               // 补字符串结束符
            return true;                 // 截取成功
        }
        if (i < out_size - 1)            // 输出缓冲未满
            out[i++] = *src;             // 复制当前字符
        src++;                           // 指针后移
    }

    return false;                        // 遍历完都没找到目标标记
}



